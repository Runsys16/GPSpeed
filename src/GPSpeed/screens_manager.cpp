#ifndef SCREENS_MANAGER_CPP
#define SCREENS_MANAGER_CPP
//---------------------------------------------------------------------------------------------------------------------------------------------------
//
//---------------------------------------------------------------------------------------------------------------------------------------------------
#include "screens_manager.h"
//---------------------------------------------------------------------------------------------------------------------------------------------------
//
//---------------------------------------------------------------------------------------------------------------------------------------------------
Screen::Screen(TFT_eSPI* _tft)
{
  tft = _tft;
}
//---------------------------------------------------------------------------------------------------------------------------------------------------
//
//---------------------------------------------------------------------------------------------------------------------------------------------------
ScreensManager::ScreensManager(TFT_eSPI* _tft)
{
  uNbScreens = 0;
  for( int i=0; i<MAX_SCREENS; i++)
  {
    screens[i] = NULL;
  }
  iActiveScreen   = -1;
  iPreviousActive = -1;
  iScreenReturn   = -1;
  tft = _tft;
}
//---------------------------------------------------------------------------------------------------------------------------------------------------
//
//  Init tft
// mode affichage 
// efface l'ecran
//
//---------------------------------------------------------------------------------------------------------------------------------------------------
void ScreensManager::setup()
{
  tft->init();
  tft->setRotation(1);
  clear();
}
//---------------------------------------------------------------------------------------------------------------------------------------------------
//
//  Efface l'ecran (NOIR)
//
//---------------------------------------------------------------------------------------------------------------------------------------------------
void ScreensManager::clear()
{
  tft->fillScreen(TFT_BLACK);
}
//---------------------------------------------------------------------------------------------------------------------------------------------------
//
//  Efface l'ecran et force le réaffichage
//
//---------------------------------------------------------------------------------------------------------------------------------------------------
void ScreensManager::reDraw()
{
  iPreviousActive = -1;   // Force a affiche l'ecran active (appel de print() plutot que update())
  iScreenReturn   = -1;   // Supprime le retour (utile ??)
  clear();                // Efface l'écran
  if ( iActiveScreen != -1 )          screens[iActiveScreen]->setUpdate(true);         // active le reaffichage
}
//---------------------------------------------------------------------------------------------------------------------------------------------------
//
//---------------------------------------------------------------------------------------------------------------------------------------------------
int ScreensManager::addScreen( Screen* sc)
{
  if ( sc == NULL )               return -1;
  if ( uNbScreens>=MAX_SCREENS )  return -1;

  screens[uNbScreens] = sc;
  uNbScreens++;
  return uNbScreens-1;
}
//---------------------------------------------------------------------------------------------------------------------------------------------------
//
//---------------------------------------------------------------------------------------------------------------------------------------------------
void ScreensManager::delScreen( Screen* sc )
{
  if ( uNbScreens <= 0)    return;
  if ( sc == NULL )     return;

  for( int i=0; i<MAX_SCREENS; i++)
  {
    if ( screens[i] == sc )       screens[i] = NULL;
  }
  uNbScreens--;
}
//---------------------------------------------------------------------------------------------------------------------------------------------------
//
//---------------------------------------------------------------------------------------------------------------------------------------------------
void ScreensManager::setActive( int i )
{
  if ( i<0 && i >= MAX_SCREENS )      return;
  if ( iActiveScreen == i )           return;
  
  Serial.printf( "Changement d'ecran : %d-%p\n", i, screens[i] );

  clear();
  iPreviousActive = -1;
  iActiveScreen = i;
  screens[iActiveScreen]->setUpdate(true);
}
//---------------------------------------------------------------------------------------------------------------------------------------------------
//
//---------------------------------------------------------------------------------------------------------------------------------------------------
void ScreensManager::setActiveTime( int i, int t )
{
  if ( i<0 && i >= MAX_SCREENS )      return;
  if ( iScreenReturn == -1 )          iScreenReturn = iActiveScreen;

  Serial.printf( "Changement d'ecran : %d-%p %d\n", i, screens[i], t);

  clear();
  uTimeElapsed = millis() + t;
  screens[i]->setUpdate(true);
  iActiveScreen = i;
  iPreviousActive = -1;
}
//---------------------------------------------------------------------------------------------------------------------------------------------------
//
//---------------------------------------------------------------------------------------------------------------------------------------------------
void ScreensManager::loop(void)
{
  if ( iActiveScreen == -1 )                      return;
  if ( screens[iActiveScreen]->isUpdate() )
  {
    if ( iPreviousActive == iActiveScreen )       screens[iActiveScreen]->update();
    else                                          screens[iActiveScreen]->print();
  } 

  iPreviousActive = iActiveScreen;

  if ( iScreenReturn != -1 )
  {
    unsigned long uCurrent = millis();
    //Serial.println( uCurrent );
    if ( uCurrent>uTimeElapsed )
    {
      setActive(iScreenReturn);
      iScreenReturn = -1;
    }
  }
}
//---------------------------------------------------------------------------------------------------------------------------------------------------
//
//---------------------------------------------------------------------------------------------------------------------------------------------------
#endif
