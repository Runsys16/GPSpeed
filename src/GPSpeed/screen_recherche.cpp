#ifndef SCREEN_RECHERCHE_CPP
#define SCREEN_RECHERCHE_CPP
//---------------------------------------------------------------------------------------------------------------------------------------------------
//
//---------------------------------------------------------------------------------------------------------------------------------------------------
//#define DEBUG_RECH
//---------------------------------------------------------------------------------------------------------------------------------------------------
#include "screen_recherche.h"
#include "Free_Fonts.h"
#include "sat.h"                  // image RGB-565
#include "log.h"
#include "oui-non.h"
//---------------------------------------------------------------------------------------------------------------------------------------------------
#define DX_NBS            60
#define DY_NBS            20
//---------------------------------------------------------------------------------------------------------------------------------------------------
//
//---------------------------------------------------------------------------------------------------------------------------------------------------
ScreenRecherche::ScreenRecherche(TFT_eSPI* _tft) : Screen::Screen(_tft)
{
  uTime = millis();
  pImgNbs = new TFT_eSprite(tft);
  delay(1);
  pImgNbs->createSprite(DX_NBS, DY_NBS);
  nbs = 0;
  updateNbSat();
  bAffFindSat = true;
  bFindSat = false;
}
//---------------------------------------------------------------------------------------------------------------------------------------------------
//
//---------------------------------------------------------------------------------------------------------------------------------------------------
void ScreenRecherche::setNbSat(int i)
{
  #ifdef DEBUG_RECH
    if ( nbs != i )     Serial.println( "ScreenRecherche::setNbSat("+String(i)+")" );
  #endif

  nbs = i;

  pImgNbs->fillSprite(TFT_BLACK);
  pImgNbs->setFreeFont(FSS9);
  pImgNbs->setTextDatum(TL_DATUM);
  pImgNbs->setTextColor(TFT_GOLD);

  String str = "";
  for( i=0; i<nbs; i++)      str = str + ".";

  pImgNbs->drawString(str, 0, 0);

}
//---------------------------------------------------------------------------------------------------------------------------------------------------
//
//---------------------------------------------------------------------------------------------------------------------------------------------------
void ScreenRecherche::setFindSat(bool b)
{
  #ifdef DEBUG_RECH
    if ( b != bFindSat )    Serial.println( "ScreenRecherche::setFindSat("+String(b)+")" );
  #endif
  bFindSat = b;
  bAffFindSat = true;
}
//---------------------------------------------------------------------------------------------------------------------------------------------------
//
//---------------------------------------------------------------------------------------------------------------------------------------------------
void ScreenRecherche::print(void)
{
  update();

  //bUpdate = false;
  bAff = false;
  bEff = false;
}
//---------------------------------------------------------------------------------------------------------------------------------------------------
//
//---------------------------------------------------------------------------------------------------------------------------------------------------
void ScreenRecherche::updateNbSat()
{
    pImgNbs->pushSprite(10, tft->height()-20);
}
//---------------------------------------------------------------------------------------------------------------------------------------------------
//
//---------------------------------------------------------------------------------------------------------------------------------------------------
void ScreenRecherche::updateFindSat()
{
  if ( bAffFindSat ) {
    tft->setSwapBytes(true);
    if ( bFindSat )       tft->pushImage(10, 10, 32, 32, oui);
    else                  tft->pushImage(10, 10, 32, 32, non);
  }
  bAffFindSat = false;
}
//---------------------------------------------------------------------------------------------------------------------------------------------------
//
//---------------------------------------------------------------------------------------------------------------------------------------------------
void ScreenRecherche::update(void)
{
  unsigned long uCurrent = millis();

  if ( uCurrent > (uTime+500) )
  {
    if ( !bAff ){
      unsigned x = (tft->width()  - 128) / 2;
      unsigned y = (tft->height() - 96) / 2;

      tft->setSwapBytes(true);
      tft->pushImage(x, y, 128, 96, sat);

      bAff = true;
      bEff = false;
    }
  }
  else
  {
    if ( !bEff ){
      tft->fillScreen(TFT_BLACK);

      bAff = false;
      bEff = true;
      bAffFindSat = true;
    }
  }
  
  if ( uCurrent > (uTime+1500) )      uTime = uCurrent;
  //------------------------------------
  // Affcichage du nombre de satellites
  updateNbSat();
  updateFindSat();
}

#endif
